/**
 *
 * All rights reserved.
 * Copyright (C) 2020 by LIKE, University of Erlangen-Nuernberg
 *
 * The standard ETSI TS 103 357 TS-UNB is protected by patents. For
 * information about licensing contact the mioty(R) alliance: http://mioty-alliance.com
 *
 *
 * @brief Implements the transmission of radio bursts using the HopeRF RFM95HW module
 * 
 * @file Rfm95w.h
 * @author Joerg Robert
 * @date 2020-10-06
 */

#ifndef RFM95W_H_
#define RFM95W_H_

#include <stdint.h>

#include "../Utils/BitAccess.h"


namespace TsUnbLib {
namespace Trx {



//! Write access to the 'RegFrfMsb' register
#define RFM95_WRITE_FRF		        0x86

//! Write access to the 'RegOpMode' register
#define RFM95_WRITE_MODE        	0x81

//! Register value for sleep mode
#define RFM95_MODE_SLEEP        	0x00

//! Register value for standby mode
#define RFM95_MODE_STDBY        	0x01

//! Register value for frequency synth. mode
#define RFM95_MODE_FS           	0x02

//!brief Set transceiver into transmitter mode
#define RFM95_MODE_TX           	0x03

//! Array used for initialization of the transceiver, format: length, address, one or multiple data
#define RFM95_CONFIG_ARRAY  {\
    2, 0x80 + 0x01, 0x01,\
    2, 0x80 + 0x31, 0x00,\
    2, 0x80 + 0x14, 0x00,\
    2, 0x80 + 0x09, 0x4B,\
    2, 0x80 + 0x0B, 0x00,\
    2, 0x80 + 0x44, 0x80 + 0x2d,\
    3, 0x80 + 0x04, 0x00, 0x00,\
    2, RFM95_WRITE_MODE, RFM95_MODE_SLEEP,\
    0}
/*

#define RFM95_CONFIG_ARRAY  {\
    2, 0x80 + 0x01, 0x00,\
    3, 0x80 + 0x02, 0x34, 0x83,\
    3, 0x80 + 0x04, 0x00, 0x0a,\     
    2, 0x80 + 0x09, 0x4B,\  
    2, 0x80 + 0x0a, 0x29,\
    2, 0x80 + 0x0b, 0x00,\     
    3, 0x80 + 0x25, 0x00, 0x00,\
    2, 0x80 + 0x27, 0x08,\
    2, 0x80 + 0x30, 0x00,\         
    3, 0x80 + 0x31, 0x00, 0x06,\
    2, 0x80 + 0x35, 0x80,\
    2, 0x80 + 0x44, 0x80 + 0x2d,\
    2, 0x80 + 0x5d, 0x05,\    
    0}
    */
/*
    2, 0x80 + 0x01, 0x01,\
    3, 0x80 + 0x02, 0x34, 0x83,\
    2, 0x80 + 0x5d, 0x05,\
    3, 0x80 + 0x04, 0x00, 0x0a,\
    2, 0x80 + 0x09, 0x4B,\  
    2, 0x80 + 0x0a, 0x49,\
    2, 0x80 + 0x0b, 0x00,\
    3, 0x80 + 0x25, 0x00, 0x00,\
    2, 0x80 + 0x27, 0x00,\
    2, 0x80 + 0x30, 0x80,\
    2, 0x80 + 0x31, 0x40,\
    2, 0x80 + 0x32, 0x05,\
    2, 0x80 + 0x35, 0x80,\
    2, 0x80 + 0x44, 0x80 + 0x2d,\
    2, RFM95_WRITE_MODE, RFM95_MODE_SLEEP,\
*/
/**
 * @brief Implementation of burst transmission using the HopeRF RFM95HW
 *
 * This class implements the transmission of the radio bursts using the HopeRF RFM95HW
 * transmitter module. For this purpose the transmitter is switched into the continuous
 * transmission mode and the symbol clock is generated by the microcontroller.
 * The frequency deviation is set to zeros. Instead this implementation directly changes 
 * the transmission frequency for the modulation of the data.
 *
 * Depending on the actual transmitter module the template parameter BOOST_PIN must be set to true.
 * However, some modules do only support one of the modes. For transmit powers >13dBm the BOOST_PIN
 * must be always set to true, which requires the module to support it.
 *
 * The template parameter F_DEV defines the frequency deviation. The RFM95HW has a minimum step size of
 * exactly 61.03515625Hz. The required frequency deviation for the standard mode is 2380.371Hz / 4 =
 * 595.09275Hz, which cannot be achieved 61.03515625Hz. This would require a frequency deviation of 9.75.
 * Though, a frequency deviation of 10 (610.3515625Hz) results has shown to work properly. For other modes
 * the frequency deviation may be adjusted.
 *
 * The template class RadioBurst_T defines a radio burst data structure. The actual implementation has to
 * offer the methods: uint16_t getBurstLength(void), uint8_t* getBurst(void), uint16_t get_channel(void).
 *
 * At an early stage in the program the init() method shall be called. It brings the device into the sleep
 * mode to save energy. It is not part of the constructor to allow the user to start a watchdog before
 * calling the init() method.
 *
 */
template <class Cpu_T, bool BOOST_PIN = false, uint32_t F_DEV = 10, 
    class RadioBurst_T = TsUnb::RadioBurst<> >
class Rfm95w {
public:
  Cpu_T Cpu;
	Rfm95w() {
		txPower = 13;
	}

	~Rfm95w() {
	}


	/**
	 * @brief Init method
	 *
	 * This module initializes the RFM69HW and brings it into sleep mode.
	 * It must be called before the send function. Furthermore, it shall
	 * be called as early as possible in the code to bring the RFM69HW
	 * into sleep mode to save energy after power on.
	 *
	 * @return 0 if OK, negative falue in case of errors
	 */
	int16_t init(void) {
		// TODO check if chips is actually present and return negative value in case of error
		Cpu.spiInit();

		/*
		 * Initialize with presets
		 */
		const uint8_t presets[] = RFM95_CONFIG_ARRAY;
		uint8_t idx = 0;
		while (presets[idx] != 0) {
			Cpu.spiSend(&presets[idx + 1], presets[idx]);
			idx += presets[idx] + 1;
		}
		setMode(RFM95_MODE_SLEEP);

		Cpu.spiDeinit();

		return 0;
	}

int16_t transmit(const RadioBurst_T* const Bursts, const uint16_t numTxBursts, const uint32_t frequency) {
		Cpu.spiInit();
		Cpu.initTimer();

		setTxPwrReg(txPower);

		// Give the system the time of four bits to initialize everything (approx. 10ms)
		Cpu.addTimerDelay(4);
		Cpu.startTimer();
		for (uint16_t burstIdx = 0; burstIdx < numTxBursts;	++burstIdx) {
			const uint32_t cFrequency = (uint32_t) Bursts[burstIdx].getCarrierOffset();

			/*
			 * Transmission of very first bit of the radio burst. We
			 * have to switch on the transmitter
			 */
			if (Bursts[burstIdx].getBurstLength() > 0) {
				const uint8_t bit =	readBit(0, Bursts[burstIdx].getBurst());
				const uint32_t modFreq = frequency + cFrequency + calcFdev(bit);
				setFrequencyReg(modFreq);

				Cpu.waitTimer();
				setMode(RFM95_MODE_TX);
				Cpu.addTimerDelay(1);
			}

			/*
			 * Transmission of all remaining bits in the burst.
			 */
			for (uint16_t bitIdx = 1; bitIdx < Bursts[burstIdx].getBurstLength(); ++bitIdx) {
				const uint8_t bit = readBit(bitIdx,	Bursts[burstIdx].getBurst());
				const uint32_t modFreq = frequency + cFrequency + calcFdev(bit);
				Cpu.waitTimer();
				setFrequencyReg(modFreq);
				Cpu.addTimerDelay(1);
			}

			/*
			 * Wait until the last bit to be transmitted and switch to sleep mode.
			 */
			Cpu.waitTimer();
			setMode(RFM95_MODE_SLEEP);

			/*
			 * If we are not in the last burst wait for the next burst to start.
			 * If we are in the last burst we do not have to restart the counter again.
			 */
			if (burstIdx + 1 < numTxBursts) {
				Cpu.addTimerDelay((int16_t)Bursts[burstIdx].get_T_RB() - Bursts[burstIdx].getBurstLength());
			}
		}
		Cpu.stopTimer();
		Cpu.spiDeinit();

		return 0;
	}

	
	//int16_t transmit(const RadioBurst_T* const Bursts, const uint16_t numTxBursts, const uint32_t frequency) {
	//	Cpu.spiInit();
		
	//	Cpu.initTimer();
	//	setTxPwrReg(txPower);

		// Give the system the time of four bits to initialize everything (approx. 10ms)
	//	Cpu.addTimerDelay(4);
	//	Cpu.startTimer();
		
	//	for (uint16_t burstIdx = 0; burstIdx < numTxBursts;	++burstIdx) {
      // Special handling in case of zero length bursts
  //    if (Bursts[burstIdx].getBurstLength() == 0) {
  //          Cpu.waitTimer();
  //          if (burstIdx + 1 < numTxBursts) {
  //              Cpu.addTimerDelay((int16_t)Bursts[burstIdx].get_T_RB() - Bursts[burstIdx].getBurstLength());
  //          }      
  //          continue;
  //    }

	//		const uint32_t cFrequency = (uint32_t) Bursts[burstIdx].getCarrierOffset();
  //    const uint32_t modFreq = frequency + cFrequency;
  //    Cpu.waitTimer();
  //    setFrequencyReg(modFreq);

  //    const uint8_t* burstData = Bursts[burstIdx].getBurst() ;
  //    for (uint8_t byteIdx = 0; byteIdx < Bursts[burstIdx].getBurstLengthBytes(); ++byteIdx) {
  //    			uint8_t data[2] = {0x80, burstData[byteIdx]};
  //          Cpu.spiSend(data, 2);
  //    }
      
      // Add one dummy byte, if this byte is actually TX, the TX switches itself into sleep mode 
      // because we did not reac the sleep command
  //    /*{
  //     			uint8_t data[2] = {0x80, 0};
  //          Cpu.spiSend(data, 2);
  //    }*/
  //    setMode(RFM95_MODE_FS);

  //    Cpu.addTimerDelay(1);
  //    Cpu.waitTimer();
  //    setMode(RFM95_MODE_TX);
      
  //    Cpu.addTimerDelay(Bursts[burstIdx].getBurstLength());
  //    Cpu.waitTimer();
  //    setMode(RFM95_MODE_SLEEP);

	//		/*
	//		 * If we are not in the last burst wait for the next burst to start.
	//		 * If we are in the last burst we do not have to restart the counter again.
	//		 */
	//		if (burstIdx + 1 < numTxBursts) {
	//			  Cpu.addTimerDelay((int16_t)Bursts[burstIdx].get_T_RB() - Bursts[burstIdx].getBurstLength() - 1);
	//		}
	//	}
	//	Cpu.waitTimer();
	//	setMode(RFM95_MODE_SLEEP);
	//	Cpu.stopTimer();
	//	Cpu.spiDeinit();

	//	return 0;
	//}

	/**
	 * @brief Sets the transmit power
	 *
	 * This method is used to set the transmit power in dBm.
	 * The default transmit power is 13dBm.
	 *
	 * @param 	power	Transmit power in dBm
	 */
	void setTxPower(const int8_t power) {
		  txPower = power;
	}

private:
	/**
	 * @brief Set frequency register
	 *
	 * This method sets the frequency register to the value frequency.
	 * Caution: This method assumes that SPI is initialized!
	 *
	 */
	void setFrequencyReg(const uint32_t frequency) {
		/*
		 * Union to simplify byte access.
		 */
		union splituint32 {
			uint8_t bytes[4];
			uint32_t single;
		};
		union splituint32 regVal;
		regVal.single = frequency;
		uint8_t data[4] = {
				RFM95_WRITE_FRF, regVal.bytes[2],
				regVal.bytes[1], regVal.bytes[0]};
		Cpu.spiSend(data, 4);
	}
	
	/**
	 * @brief Set the transmit power register
	 *
	 * This methods sets the transmit power in the register.
	 * Caution: This method assumes that SPI is initialized!
	 *
	 * Details how on setting the transmit power can be found
	 * in the RFM95HW datasheet.
	 *
	 * @param	power	Transmit power in dBm
	 *
	 * @return	The actually set transmit power.
	 */
	int8_t setTxPwrReg(int8_t power) {
		// Special handling if boost pin is used
		if (BOOST_PIN) {
			if (power > 20)
				power = 20;
			if (power < 2)
				power = 2;

    	uint8_t regPower = power - 2;
    	// Enable PA Dac for more than 17, this will boost by 3dB
    	if (power > 17) {
        const uint8_t data[2] = {0x80 + 0x4d, 0x87};
        Cpu.spiSend(data, 2);
        
        // Correct register by 3dB
        regPower -= 3;
    	}
    	else {
    		// Disable DAC otherwise
        const uint8_t data[2] = {0x80 + 0x4d, 0x84};
	      Cpu.spiSend(data, 2);
    	}

			uint8_t data[2] = {0x80 + 0x09, 0xF0 | regPower};
			Cpu.spiSend(data, 2);
			
			return power;
		}
		else {
			// PA Boost Pin is not used

			// Limit to valid power range
			if (power > 15)
				power = 15;
			if (power < 0)
				power = 0;

			uint8_t regPower = power;

			uint8_t data[2] = {0x80 + 0x09, 0x70 | regPower};
			Cpu.spiSend(data, 2);

			return power;
		}
	}

	/**
	 * @brief Set RFM95W mode
	 *
	 * This methods sets the power mode of the RFM69HW.
	 * Caution: This method assumes that SPI is initialized!
	 *
	 * @param	mode	RFM95W mode according to datasheet
	 */
	void setMode(const uint8_t mode) {
		uint8_t data[2] = {RFM95_WRITE_MODE, mode};
		Cpu.spiSend(data, 2);
	}
	
	/**
	 * @brief Calculates the frequency deviation
	 *
	 * This method calculates the frequency deviation for each bit
	 * and returns it in frequency register offset.
	 *
	 * @param	bit	Bit value, i.e. 0 or 1
	 *
	 * @return	Frequency deviation in register values
	 */
	int16_t calcFdev(const uint8_t bit) const {
		if (bit)
			return (int16_t)F_DEV;
		else
			return (int16_t)(-F_DEV);
	}


	//! Internal register to store the transmit power
	int8_t txPower;
};


};	// namespace Trx
};	// namespace TsUnbLib

#endif	/*RFM95HW_H_*/
